## conf/bblayers.conf
```bitbake
# =============================================================================
# bblayers.conf — layer stack for raspi-drone
# =============================================================================
# ${TOPDIR} resolves to the build/ directory.
# All layer paths are expressed relative to it so the project is relocatable.

POKY_BBLAYERS_CONF_VERSION = "2"

BBPATH  = "${TOPDIR}"
BBFILES ?= ""

BBLAYERS ?= " \
  ${TOPDIR}/../poky/meta                            \
  ${TOPDIR}/../poky/meta-poky                       \
  ${TOPDIR}/../poky/meta-yocto-bsp                  \
  ${TOPDIR}/../meta-openembedded/meta-oe            \
  ${TOPDIR}/../meta-openembedded/meta-python        \
  ${TOPDIR}/../meta-openembedded/meta-networking    \
  ${TOPDIR}/../meta-raspberrypi                     \
  ${TOPDIR}/../meta-raspi-drone                     \
  "
```

## conf/local.conf
```bitbake
# =============================================================================
# Yocto local.conf — Raspberry Pi CM5 / raspi-drone
# Yocto release: scarthgap (5.0 LTS)
# =============================================================================

# Target machine
# The CM5 uses the BCM2712 SoC (same as Pi 5).
# Requires meta-raspberrypi >= scarthgap with CM5 support.
# Fallback: set to "raspberrypi5" if raspberrypi-cm5 is not yet in your branch.
MACHINE = "raspberrypi-cm5"

# Base distribution
DISTRO = "poky"

# Use RPM as the package format
PACKAGE_CLASSES = "package_rpm"

# -----------------------------------------------------------------------------
# Parallelism — adapt to your host machine
# -----------------------------------------------------------------------------
BB_NUMBER_THREADS ?= "${@oe.utils.cpu_count()}"
PARALLEL_MAKE     ?= "-j ${@oe.utils.cpu_count()}"

# -----------------------------------------------------------------------------
# Shared download and sstate cache (outside the build dir to survive rebuilds)
# -----------------------------------------------------------------------------
DL_DIR    ?= "${TOPDIR}/../downloads"
SSTATE_DIR ?= "${TOPDIR}/../sstate-cache"

# -----------------------------------------------------------------------------
# Image output format — produces a flashable .img for SD / eMMC
# -----------------------------------------------------------------------------
IMAGE_FSTYPES = "rpi-sdimg ext4"

# -----------------------------------------------------------------------------
# Raspberry Pi hardware settings
# -----------------------------------------------------------------------------
ENABLE_UART = "1"
GPU_MEM     = "64"

# Disable splash screen for faster boot
DISABLE_SPLASH = "1"

# -----------------------------------------------------------------------------
# Image features applied globally (per-image settings live in the recipe)
# -----------------------------------------------------------------------------
EXTRA_IMAGE_FEATURES ?= "debug-tweaks"

# -----------------------------------------------------------------------------
# Misc
# -----------------------------------------------------------------------------
CONF_VERSION = "2"
```

## layers/meta-drone/conf/distro/drone-os.conf
```bitbake
require conf/distro/poky.conf

DISTRO = "drone-os"
DISTRO_NAME = "DroneOS"
DISTRO_VERSION = "1.2"

# Bootloader
PREFERRED_PROVIDER_virtual/bootloader = "u-boot"
PREFERRED_PROVIDER_u-boot = "u-boot"
RPI_USE_U_BOOT = "1"

# Init system
INIT_MANAGER = "systemd"
VIRTUAL-RUNTIME_init_manager = "systemd"
VIRTUAL-RUNTIME_initscripts = ""
DISTRO_FEATURES:append = " systemd usrmerge rauc"
DISTRO_FEATURES:remove = "sysvinit"

# Modem
PACKAGECONFIG:append:pn-networkmanager = " modemmanager"
PACKAGECONFIG:append:pn-modemmanager = " qmi mbim"

# Kernel
CMDLINE:append = " audit=0"

# Partition layout
WKS_FILE = "drone-image.wks.in"
IMAGE_FSTYPES:append = " ext4 wic wic.bz2 wic.bmap"
```

## layers/meta-drone/conf/layer.conf
```bitbake
# We have a conf and classes directory, add to BBPATH
BBPATH .= ":${LAYERDIR}"

# We have recipes-* directories, add to BBFILES
BBFILES += "${LAYERDIR}/recipes-*/*/*.bb \
            ${LAYERDIR}/recipes-*/*/*.bbappend"

BBFILE_COLLECTIONS += "meta-drone"
BBFILE_PATTERN_meta-drone = "^${LAYERDIR}/"
BBFILE_PRIORITY_meta-drone = "6"

LAYERDEPENDS_meta-drone = "core"
LAYERSERIES_COMPAT_meta-drone = "scarthgap"
```

## layers/meta-drone/conf/machine/drone-cm5.conf
```bitbake
#@TYPE: Machine
#@NAME: Drone CM5
#@DESCRIPTION: Drone CM5 on Kelvin carrier board

KMACHINE = "raspberrypi-cm5-io-board"
require conf/machine/raspberrypi-cm5-io-board.conf


# UARTs Kelvin carrier board
RPI_EXTRA_CONFIG = '\n\
# Kelvin carrier board\n\
dtoverlay=uart0-pi5\n\
dtoverlay=uart2-pi5\n\
dtoverlay=uart4-pi5\n\
\n\
# CAN - MCP2515 on SPI1 CS0 (GPIO18), INT GPIO25\n\
dtparam=spi=on\n\
dtoverlay=spi1-1cs\n\
dtoverlay=mcp2515,spi1-0,oscillator=8000000,interrupt=25\n\
\n\
# Dual IMX219\n\
start_x=1\n\
gpu_mem=256\n\
dtoverlay=imx219,cam0\n\
dtoverlay=imx219,cam1\n\
'

KERNEL_MODULE_AUTOLOAD += "can can-raw mcp251x"
```

## layers/meta-drone/conf/machine/drone-rpi5.conf
```bitbake
#@TYPE: Machine
#@NAME: Drone RPi5
#@DESCRIPTION: Drone RPi5 development board

require conf/machine/raspberrypi5.conf

# UART2 for Flight Controller (ttyAMA2)
RPI_EXTRA_CONFIG = '\n\
# Drone RPi5\n\
dtoverlay=uart2-pi5\n\
'
```

## meta-raspi-drone/conf/layer.conf
```bitbake
# =============================================================================
# meta-raspi-drone/conf/layer.conf
# =============================================================================

BBPATH .= ":${LAYERDIR}"

BBFILES += "${LAYERDIR}/recipes-*/*/*.bb \
            ${LAYERDIR}/recipes-*/*/*.bbappend"

BBFILE_COLLECTIONS += "raspi-drone"
BBFILE_PATTERN_raspi-drone  = "^${LAYERDIR}/"
BBFILE_PRIORITY_raspi-drone = "10"

# Declare dependencies on other layers
LAYERDEPENDS_raspi-drone = "core openembedded-layer raspberrypi"

# Compatible Yocto release series
LAYERSERIES_COMPAT_raspi-drone = "scarthgap"
```
